// vim: set ft=dts:

#include <dt-bindings/zmk/input_transform.h>

&spi0 {
  status = "disabled";
  compatible = "nordic,nrf-spim";
  
  trackball2: trackball2@0 {
    status = "okay";
    compatible = "pixart,pmw3610";
    reg = <0>;
    spi-max-frequency = <2000000>;
    irq-gpios = <&gpio0 6 (GPIO_ACTIVE_LOW | GPIO_PULL_UP)>;
    cpi = <1000>;
    evt-type = <INPUT_EV_REL>;
    x-input-code = <INPUT_REL_X>;
    y-input-code = <INPUT_REL_Y>;
  };
};