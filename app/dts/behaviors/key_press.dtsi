/*
 * Copyright (c) 2020 The ZMK Contributors
 *
 * SPDX-License-Identifier: MIT
 */

/ {
    behaviors {
        kp: behavior_key_press {
            compatible = "zmk,behavior-key-press";
            #binding-cells = <1>;
        };
    };
};